/*
    This sketch demonstrates how to set up a simple HTTP-like server.
    The server will set a GPIO pin depending on the request
      http://server_ip/gpio/0 will set the GPIO2 low,
      http://server_ip/gpio/1 will set the GPIO2 high
    server_ip is the IP address of the ESP8266 module, will be
    printed to Serial when the module is connected.
*/

#include <ESP8266WiFi.h>
#include <Hash.h>
#include <EEPROM.h>
#include "Pins.h"
#include "config.h"
#include "httpStatus.h"
#include "switch.h"

// The certificate is stored in PMEM
static const uint8_t x509[] PROGMEM = {
  0x30, 0x82, 0x01, 0x33, 0x30, 0x81, 0xde, 0x02, 0x09, 0x00, 0xcb, 0xab,
  0xa5, 0x1d, 0xbf, 0xe3, 0x5a, 0xc4, 0x30, 0x0d, 0x06, 0x09, 0x2a, 0x86,
  0x48, 0x86, 0xf7, 0x0d, 0x01, 0x01, 0x0b, 0x05, 0x00, 0x30, 0x20, 0x31,
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  0x41, 0x88, 0xfe, 0x1f, 0x8f, 0x13, 0xdf, 0xf0, 0xe5, 0x3c, 0xbc
};

// And so is the key.  These could also be in DRAM
static const uint8_t rsakey[] PROGMEM = {
  0x30, 0x82, 0x01, 0x3a, 0x02, 0x01, 0x00, 0x02, 0x41, 0x00, 0xc0, 0x48,
  0x0e, 0xd7, 0xbc, 0x8b, 0x54, 0x09, 0x99, 0xe9, 0xb3, 0x92, 0x60, 0x7d,
  0x97, 0x7f, 0x52, 0x94, 0x87, 0x6d, 0xd4, 0x75, 0x9f, 0x15, 0x5e, 0x15,
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  0xbf, 0x4c, 0x49, 0xa1, 0x7f, 0xe4
};

// Create an instance of the server
// specify the port to listen on as an argument
WiFiServer http_server(80);
WiFiServerSecure https_server(443);


boolean restartFlag = false;
IPAddress myIP;

void setup() {
  int i;

  switch_setupInitOutputs();

  Serial.begin(9600);
  EEPROM.begin(512);

  Serial.println();
  Serial.println();

  if (analogRead(A0) > 1000) {
    config_reset();
  }

  config_read();

  switch_setupOutputsFromCfg();

  pinMode(D4, OUTPUT);
  digitalWrite(D4, LOW);

  if (cfg_ssid[0]) {
    // Connect to WiFi network
    Serial.print(F("Connecting to "));
    Serial.println(cfg_ssid);
  
    WiFi.mode(WIFI_STA);
    WiFi.begin(cfg_ssid, cfg_key);
    if ((uint32_t)cfg_ip) {
      WiFi.config(cfg_ip, cfg_gateway, cfg_netmask);
    }
  
    while (WiFi.status() != WL_CONNECTED) {
      delay(500);
      Serial.print(F("."));
      serial_loop();
    }
    Serial.println();
    Serial.println(F("WiFi connected"));
    myIP = WiFi.localIP();
  } else {
    Serial.println("Configuring access point...");
    WiFi.softAP("QuadThing");
    //WiFi.softAPConfig(ip, gateway, subnet);
    myIP = WiFi.softAPIP();
  }

  // Start the server
  http_server.begin();
  https_server.setServerKeyAndCert_P(rsakey, sizeof(rsakey), x509, sizeof(x509));
  https_server.begin();
  Serial.println(F("Server started"));

  // Print the IP address
  Serial.print("Server IP address: ");
  Serial.println(myIP);
}

void loop() {
  digitalWrite(D4, HIGH);
  if (restartFlag) {
    ESP.restart();
  }
  serial_loop();
  http_loop();
  https_loop();
  switch_loop();
}

void http_loop() {
  HttpResponse response;
  // Check if a client has connected
  WiFiClient client = http_server.available();
  if (!client) {
    return;
  }
  digitalWrite(D4, LOW);
  Serial.println(F("------------------------------HTTP"));
  Serial.println(client.remoteIP());

  client.setTimeout(5000); // default is 1000

  // Read the first line of the request
  String req = client.readStringUntil('\r');
  if (req.length() == 0) {
    Serial.println("empty request");
    return;
  }
  Serial.print(F("request: "));
  Serial.println(req);
  String path = req.substring(req.indexOf(' '), req.lastIndexOf(' '));
  path.trim();
  Serial.println(path);

  client.setTimeout(100);

  client.readString();

  response = http_redirect(myIP, path.c_str());
  client.print(response.toString());
}

void https_loop() {
  HttpResponse response;

  // Check if a client has connected
  WiFiClientSecure client = https_server.available();
  if (!client) {
    return;
  }
  digitalWrite(D4, LOW);
  Serial.println(F("------------------------------HTTPS"));
  Serial.println(client.remoteIP());

  client.setTimeout(5000); // default is 1000

  // Read the first line of the request
  String req = client.readStringUntil('\r');
  if (req.length() == 0) {
    Serial.println("empty request");
    return;
  }
  Serial.print(F("request: "));
  Serial.println(req);
  String path = req.substring(req.indexOf(' '), req.lastIndexOf(' '));
  String params;
  int i = path.indexOf("?");
  if (i != -1) {
    params = path.substring(i + 1);
    path.remove(i);
  }
  path.trim();
  Serial.println(path);
  Serial.println(params);

  client.setTimeout(100);

  String httpHeaders = client.readString();
  String postVars;
  i = httpHeaders.indexOf("\r\n\r\n");
  if (i != -1) {
    postVars = httpHeaders.substring(i+4);
    httpHeaders.remove(i);
  }
  Serial.println(postVars);
  String pass = getPassFromHeaders(httpHeaders);
  Serial.println(pass);
  Serial.println(sha1(pass));

  if (!checkPass(pass)) {
    response = http_askForLogin();
  } else if (path.equals("/")) {
    response = http_redirect(myIP, "/p/home");
  } else if (path.equals("/c/pass")) {
    config_setNewPass(postVars);
    response = http_redirect(myIP, "/p/pass");
  } else if (path.equals("/c/network")) {
    config_setNetwork(postVars);
    response = http_redirect(myIP, "/p/network");
    restartFlag = true;
  } else if (path.equals("/c/config")) {
    config_outputCount(postVars);
    response = http_redirect(myIP, "/p/config");
    restartFlag = true;
  } else if (path.equals("/p/network")) {
    response = pageNetwork();
  } else if (path.equals("/p/config")) {
    response = page_config();
  } else if (path.equals("/p/home")) {
    response = pageHome();
  } else if (path.equals("/p/pass")) {
    response = pagePass();
  } else if (path.equals("/restart")) {
    response = http_redirect(myIP, "/p/home");
    restartFlag = true;
  } else if (path.equals("/api/states")) {
    response = page_apiStates();
  } else if (path.equals("/api/switch")) {
    i = switch_multiOutputs(params);
    response = page_apiGenericResponse(String(i, DEC));
  } else if (path.equals("/css/global")) {
    response = page_css();
  } else if (path.equals("/switch")) {
    switch_outputs(params);
    response = http_redirect(myIP, "/p/home");
  } else {
    response = http_notFound();
  }
  client.print(response.toString());
  client.flush();
}
